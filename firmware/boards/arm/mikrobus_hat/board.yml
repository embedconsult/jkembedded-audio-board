## firmware/boards/arm/mikrobus_hat/board.yml
```yaml
board:
  name: mikrobus_hat
  full_name: JK-Embedded mikroBUS HAT MSPM0 mux controller
  vendor: jkembedded
  socs:
    - name: mspm0l1105
```

## firmware/mspm0-gpo-extender/boards/arm/jkembedded_mikrobus_hat_mspm0/Kconfig.board
```kconfig
# JK-Embedded mikroBUS HAT MSPM0 mux controller board configuration
config BOARD_JKEMBEDDED_MIKROBUS_HAT_MSPM0
bool "JK-Embedded mikroBUS HAT MSPM0 mux controller"
depends on SOC_SERIES_MSPM0L

config PCA953X_TARGET
bool "Expose PCA953x-compatible I2C target"
help
  Make the MSPM0 appear as an 8-bit PCA953x GPIO expander
  so that existing Linux drivers can control the mux pins.
default y
```

## firmware/mspm0-gpo-extender/boards/arm/jkembedded_mikrobus_hat_mspm0/jkembedded_mikrobus_hat_mspm0_defconfig
```kconfig
CONFIG_GPIO=y
CONFIG_I2C=y
CONFIG_I2C_TARGET=y
CONFIG_PINCTRL=y
CONFIG_FLASH_BASE_ADDRESS=0x0
CONFIG_FLASH_SIZE=128
CONFIG_SRAM_BASE_ADDRESS=0x20000000
CONFIG_SRAM_SIZE=16
```

## firmware/mspm0-gpo-extender/boards/arm/jkembedded_mspm0/Kconfig.defconfig
```kconfig
if BOARD_JKEMBEDDED_MSPM0

config BOARD
default "jkembedded_mspm0"

config GPIO
default y

config I2C
default y

config I2C_TARGET
default y

config PINCTRL
default y

endif
```

## west.yml
```yaml
manifest:
  remotes:
    - name: embedconsult
      url-base: https://github.com/embedconsult
    - name: zephyrproject-rtos
      url-base: https://github.com/zephyrproject-rtos

  projects:
    - name: zephyr
      remote: embedconsult
      revision: audio-board
      import:
        # By using name-allowlist we can clone only the modules that are
        # strictly needed by the application.
        name-allowlist:
          - cmsis_6    # required by the ARM port for Cortex-M
          - hal_ti
```
